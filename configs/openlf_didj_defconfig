## configs/openlf_didj_defconfig
```kconfig
BR2_arm=y
BR2_arm926t=y
BR2_KERNEL_HEADERS_VERSION=y
BR2_DEFAULT_KERNEL_VERSION="2.6.31"
BR2_GCC_VERSION_4_7_X=y
BR2_TOOLCHAIN_BUILDROOT_LARGEFILE=y
BR2_TOOLCHAIN_BUILDROOT_WCHAR=y
BR2_TOOLCHAIN_BUILDROOT_CXX=y
BR2_TARGET_GENERIC_HOSTNAME="OpenLF"
BR2_TARGET_GENERIC_ISSUE="Welcome to OpenLF"
BR2_ROOTFS_DEVICE_CREATION_DYNAMIC_MDEV=y
BR2_ROOTFS_POST_BUILD_SCRIPT="$(TOPDIR)/board/OpenLF/Didj/openlf_didj_post.sh"
BR2_PACKAGE_BUSYBOX_CONFIG="$(TOPDIR)/board/OpenLF/Didj/openlf_didj_busybox_defconfig"
BR2_PACKAGE_ALSA_UTILS=y
BR2_PACKAGE_ALSA_UTILS_ALSACONF=y
BR2_PACKAGE_ALSA_UTILS_APLAY=y
BR2_PACKAGE_ALSA_UTILS_SPEAKER_TEST=y
BR2_PACKAGE_STRACE=y
BR2_PACKAGE_SDL_IMAGE_GIF=y
BR2_PACKAGE_SDL_SOUND=y
BR2_PACKAGE_SDL_SOUND_PLAYSOUND=y
BR2_PACKAGE_SDL_NET=y
BR2_PACKAGE_SDL_GFX=y
BR2_PACKAGE_DBUS=y
BR2_PACKAGE_MTD=y
BR2_PACKAGE_PYTHON=y
BR2_PACKAGE_PYTHON_CURSES=y
BR2_PACKAGE_PYTHON_READLINE=y
BR2_PACKAGE_PYTHON_SQLITE=y
BR2_PACKAGE_PYTHON_DPKT=y
BR2_PACKAGE_PYTHON_MAD=y
BR2_PACKAGE_PYTHON_NETIFACES=y
BR2_PACKAGE_PYTHON_PYGAME=y
BR2_PACKAGE_PYTHON_PYGAME_IMAGE=y
BR2_PACKAGE_PYTHON_PYGAME_FONT=y
BR2_PACKAGE_PYTHON_PYGAME_MIXER=y
BR2_PACKAGE_PYTHON_PYGAME_MIXER_MUSIC=y
BR2_PACKAGE_PYTHON_SERIAL=y
BR2_PACKAGE_ALSA_LIB_PYTHON=y
BR2_PACKAGE_LIBID3TAG=y
BR2_PACKAGE_LIBUSB=y
BR2_PACKAGE_AVAHI=y
BR2_PACKAGE_AVAHI_DAEMON=y
BR2_PACKAGE_OPENSSH=y
BR2_PACKAGE_DIALOG=y
BR2_PACKAGE_HTOP=y
BR2_TARGET_ROOTFS_UBIFS=y
BR2_TARGET_ROOTFS_UBI=y
BR2_LINUX_KERNEL=y
BR2_LINUX_KERNEL_SAME_AS_HEADERS=y
BR2_LINUX_KERNEL_PATCH="$(TOPDIR)/board/OpenLF/Didj/openlf-kernel_v0.1.patch"
BR2_LINUX_KERNEL_USE_CUSTOM_CONFIG=y
BR2_LINUX_KERNEL_CUSTOM_CONFIG_FILE="$(TOPDIR)/board/OpenLF/Didj/openlf_didj_kernel_console_defconfig"
BR2_LINUX_KERNEL_ZIMAGE=y
```

## package/i2c-utils/Config.in
```kconfig
config BR2_PACKAGE_I2C_UTILS
        bool "i2c-utils"
		default y
        help
          LeapFrog utility for initializing sound.
		  Required for ALSA to work.
```

## package/lfd/Config.in
```kconfig
config BR2_PACKAGE_LFD
        bool "lfd"
		default y
        help
          LeapFrog Daemon used for sound, backlight and battery.
		  Required for ALSA to work.
```
